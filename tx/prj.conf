## CMakeLists.txt
```
# SPDX-License-Identifier: Apache-2.0

cmake_minimum_required(VERSION 3.20.0)
find_package(Zephyr REQUIRED HINTS $ENV{ZEPHYR_BASE})
project(periodic_adv)

target_sources(app PRIVATE
  src/main.c
  src/serial.c)
```

## prj.conf
```kconfig
CONFIG_BT=y
CONFIG_BT_EXT_ADV=y
CONFIG_BT_PER_ADV=y
CONFIG_BT_DEBUG_LOG=y
CONFIG_BT_DEVICE_NAME="santa"
CONFIG_ASSERT=y

CONFIG_BT_EXT_ADV_MAX_ADV_SET=4
CONFIG_BT_CTLR_ADV_DATA_LEN_MAX=1650

CONFIG_RING_BUFFER=y
CONFIG_UART_INTERRUPT_DRIVEN=y

## Enable logging (and redirect printk to log output)
CONFIG_LOG=y
CONFIG_LOG_PRINTK=y
CONFIG_LOG_MODE_IMMEDIATE=y

## Free up UART
CONFIG_SERIAL=y
CONFIG_UART_CONSOLE=y
CONFIG_LOG_BACKEND_UART=n

## Enable logging on RTT
CONFIG_LOG_BACKEND_RTT=y
CONFIG_USE_SEGGER_RTT=y
CONFIG_SEGGER_RTT_BUFFER_SIZE_UP=8192
## Always get the latest logs, even if not read yet
CONFIG_LOG_BACKEND_RTT_MODE_OVERWRITE=y

CONFIG_REBOOT=n
CONFIG_RESET_ON_FATAL_ERROR=n
```

## boards/nrf52840dk_nrf52840.overlay
```dts
&uart0 {
	compatible = "nordic,nrf-uarte";
	current-speed = <115200>;
	status = "okay";
	hw-flow-control;
};
```

## src/main.c
```c
#include <zephyr/device.h>
#include <zephyr/bluetooth/bluetooth.h>
#include <zephyr/sys/ring_buffer.h>
#include "serial.h"

#define NUM_LEDS 68
#define DATA_LEN (NUM_LEDS * 4)

static uint8_t ad_data[DATA_LEN];

/* Size of AD data format length field in octets */
#define BT_AD_DATA_FORMAT_LEN_SIZE 1U

/* Size of AD data format type field in octets */
#define BT_AD_DATA_FORMAT_TYPE_SIZE 1U

/* Device name length, size minus one null character */
#define BT_DEVICE_NAME_LEN (sizeof(CONFIG_BT_DEVICE_NAME) - 1U)

/* Device name length in AD data format, 2 bytes for length and type overhead */
#define BT_DEVICE_NAME_AD_DATA_LEN (BT_AD_DATA_FORMAT_LEN_SIZE + \
				    BT_AD_DATA_FORMAT_TYPE_SIZE + \
				    BT_DEVICE_NAME_LEN)
#define MAN_DATA_LEN (255 - BT_DEVICE_NAME_AD_DATA_LEN)

static const struct bt_data ad[] = {
	BT_DATA(BT_DATA_MANUFACTURER_DATA, ad_data, MAN_DATA_LEN),
	BT_DATA(BT_DATA_MANUFACTURER_DATA, ad_data + MAN_DATA_LEN, DATA_LEN - MAN_DATA_LEN),
};

RING_BUF_DECLARE(uart_ringbuf, 512);
static uint8_t led_data[DATA_LEN];

static struct rx_uart_header uart_header;
static struct rx_uart config = {
    .uart = DEVICE_DT_GET(DT_NODELABEL(uart0)),
    .header = &uart_header,
	.ringbuf = &uart_ringbuf,
    .packet = led_data,
    .packet_max_len = DATA_LEN,
};

#define VALIDATE(x) do {						\
		int err = x;							\
		__ASSERT(err == 0, "err %d", err);		\
	} while (0)


extern struct k_sem serial_data;

struct bt_le_ext_adv *adv;

void main(void)
{
	struct bt_le_adv_param adv_param = {
		.id = BT_ID_DEFAULT,
		.sid = 0U, /* Supply unique SID when creating advertising set */
		.secondary_max_skip = 0U,
		.options = (BT_LE_ADV_OPT_EXT_ADV | BT_LE_ADV_OPT_USE_NAME | BT_LE_ADV_OPT_USE_IDENTITY),
		.interval_min = BT_GAP_ADV_FAST_INT_MIN_2,
		.interval_max = BT_GAP_ADV_FAST_INT_MAX_2,
		.peer = NULL,
	};

	printk("Starting Periodic Advertising Demo\n");

	VALIDATE(serial_init(&config));

	/* Initialize the Bluetooth Subsystem */
	VALIDATE(bt_enable(NULL));

	/* Create a non-connectable non-scannable advertising set */
	VALIDATE(bt_le_ext_adv_create(&adv_param, NULL, &adv));

	while (true) {
		/* Wait until we have received fresh data over serial */
		k_sem_take(&serial_data, K_FOREVER);
		printk("Refreshing Advertising Data...");

		/* Stop adv (to be able to update long data) */
		VALIDATE(bt_le_ext_adv_stop(adv));

		/* Update the data */
		memcpy(ad_data, led_data, sizeof(ad_data));

		/* Set extended advertising data */
		VALIDATE(bt_le_ext_adv_set_data(adv, ad, ARRAY_SIZE(ad), NULL, 0));

		/* Start extended advertising set */
		VALIDATE(bt_le_ext_adv_start(adv, BT_LE_EXT_ADV_START_DEFAULT));

		printk("done.\n");
	}
}
```

## src/serial.c
```c
#include <zephyr/kernel.h>
#include <zephyr/device.h>
#include <zephyr/drivers/uart.h>
#include <zephyr/sys/ring_buffer.h>

#include <zephyr/sys/__assert.h>
#include <zephyr/logging/log.h>
#include "serial.h"

LOG_MODULE_REGISTER(rx_uart, 1);
K_SEM_DEFINE(serial_data, 0, 1);

static inline void cleanup_state(struct rx_uart *config)
{
    LOG_DBG("");
    memset(config->header, 0, sizeof(struct rx_uart_header));
}

/* False if header is invalid or incomplete
 * True if header complete and valid
 */
static bool build_header(struct rx_uart *uart_config)
{
    struct rx_uart_header *header = uart_config->header;

    __ASSERT_NO_MSG(header != NULL);

    if (header->idx > 6) {
        /* Header is complete, the current byte doesn't belong to it */
        return true;
    }

    uint8_t byte;

    if (ring_buf_get(uart_config->ringbuf, &byte, 1) != 1) {
        return false;
    }

    if (header->idx < 4) {
        if (byte != "UART"[header->idx]) {
            return false;
        }
        /* If the rx char matches its required value, header->idx will
         * be incremented and parsing will continue in the next call.
         * Else, we cleanup the state and return.
         */
    } else if (header->idx == 3) {
        /* Don't trigger a memset for each rx'd byte (that doesn't match
         * the header).
         */
        cleanup_state(uart_config);
    }

    switch (header->idx) {
        case 4:
            header->len = byte;
            break;
        case 5:
            header->len += byte << 8;
            break;
        case 6:
            header->crc = byte;
            break;
        default:
            break;
    }

    LOG_DBG("byte[%d]: %x", header->idx, byte);

    header->idx++;
    return false;
}

static uint8_t compute_crc(struct rx_uart_header *header, struct ring_buf *buf)
{
    /* TODO: implement crc. could be crc8_ccitt() */
    return header->crc;
}

static void process_ringbuf(struct rx_uart *uart_config)
{
    struct rx_uart_header *header = uart_config->header;

    /* try to parse header */
    while (!ring_buf_is_empty(uart_config->ringbuf) &&
           !build_header(uart_config)) {};

    /* receive the packet data */
    if (build_header(uart_config)) {
        int left = ring_buf_size_get(uart_config->ringbuf) - header->len;
        if (left >= 0) {
            LOG_DBG("ringbuf has correct size");

            if (compute_crc(header, uart_config->ringbuf) == header->crc) {
                uint16_t len = MIN(header->len, uart_config->packet_max_len);

                /* This will pull the ringbuf contents into the `packet` array,
                 * which is pointed to by the periodic advertising data.
                 * It then gets periodically refreshed in main().
                 */
                LOG_DBG("store ringbuf");
                memset(uart_config->packet, 0, uart_config->packet_max_len);
                ring_buf_get(uart_config->ringbuf, uart_config->packet, len);
                k_sem_give(&serial_data);
                LOG_HEXDUMP_DBG(uart_config->packet, uart_config->packet_max_len, "buffer");
                cleanup_state(uart_config);

                /* Re-trigger processing in case we have another packet pending. */
                process_ringbuf(uart_config);

                return;
            }
        } else {
            LOG_DBG("missing %d bytes", left);
        }
    }
}

/*
 * Read any available characters from UART, and place them in a ring buffer. The
 * ring buffer is in turn processed by process_ringbuf().
 */
void serial_cb(const struct device *uart, void *user_data)
{
    LOG_DBG("");
    struct rx_uart *uart_config = (struct rx_uart *)user_data;

    if (!uart_irq_update(uart)) {
        return;
    }

    while (uart_irq_rx_ready(uart)) {
        uint8_t byte = 0; /* Have to assign to stop GCC from whining */
        while(uart_fifo_read(uart, &byte, 1) > 0) {
            uint32_t ret = ring_buf_put(uart_config->ringbuf, &byte, 1);
            (void)ret; /* Don't warn if logging is disabled */

            LOG_DBG("rx: %x, rb put %u", byte, ret);

            process_ringbuf(uart_config);
        }
    }
}

int serial_init(struct rx_uart* uart_config)
{
    LOG_DBG("");

    /* Initialize UART driver */
    if (!device_is_ready(uart_config->uart)) {
        LOG_ERR("UART device not found!");
        return -NRF_EAGAIN;
    }

    uart_irq_callback_user_data_set(uart_config->uart, serial_cb, (void *)uart_config);
    uart_irq_rx_enable(uart_config->uart);

    LOG_DBG("init ok");

    return 0;
}
```

## src/serial.h
```c
#ifndef SERIAL_H_
#define SERIAL_H_

struct rx_uart_header {
    char start[4];		/* spells U A R T */
    uint16_t len;
    uint8_t crc;		/* CRC of whole frame */
    uint8_t idx;		/* Current index, used when building header */
};

struct rx_uart {
    const struct device *uart;

    struct rx_uart_header *header;

    /* ring buffer: stores all received uart data */
    struct ring_buf *ringbuf;

    /* packet buffer: stores only the packet to be sent out */
    char *packet;
    uint16_t packet_max_len;
};

int serial_init(struct rx_uart* uart_config);

#endif // SERIAL_H_
```
